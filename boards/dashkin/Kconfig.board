## boards/dashkin/dashkin_defconfig
```kconfig
CONFIG_SOC_SERIES_DASHKIN=y
CONFIG_SOC_DASHKIN=y
CONFIG_BOARD_DASHKIN=y
CONFIG_SERIAL=y
CONFIG_CONSOLE=y
CONFIG_UART_CONSOLE=y
CONFIG_UART_INTERRUPT_DRIVEN=y
CONFIG_SYS_CLOCK_HW_CYCLES_PER_SEC=10000000
CONFIG_XIP=n
CONFIG_GPIO=y
```

## drivers/gpio/Kconfig.dashkin
```kconfig
config GPIO_DASHKIN
	bool "DASHKIN GPIO driver"
	default y
	depends on DT_HAS_DASHKIN_GPIO_ENABLED
	help
	  Enable DASHKIN GPIO driver.
```

## drivers/uart/Kconfig.dashkin
```kconfig
# Dashkin UART configuration

# Copyright (c) 2023 Dashkin Ruslan

config UART_DASHKIN
	bool "DASHKIN UART"
	default y
	depends on DT_HAS_DASHKIN_UART_ENABLED
	select SERIAL_HAS_DRIVER
	select SERIAL_SUPPORT_INTERRUPT
	help
	  This option enables the UART driver for the DASHKIN.
```

## soc/dashkin/Kconfig.defconfig.series
```kconfig
if SOC_SERIES_DASHKIN

config SOC_SERIES
	default "dashkin"

config SYS_CLOCK_HW_CYCLES_PER_SEC
#  default $(dt_node_int_prop_int,/cpus/cpu@0,clock-frequency)
  default 1

config RISCV_SOC_INTERRUPT_INIT
  default y

config RISCV_HAS_CPU_IDLE
	default n

config RISCV_HAS_PLIC
	default y

config RISCV_GP
	default y

config 2ND_LVL_ISR_TBL_OFFSET #ISR Table offset to the first IRQ in PLIC
	default 12

config 2ND_LVL_INTR_00_OFFSET #IRQ number in the 1st level to which 2nd level controller maps
	default 11

config MAX_IRQ_PER_AGGREGATOR #Number of IRQ in PLIC
	default 50

config NUM_IRQS #First 16 IRQs are CPU exceptions
	default 25

config SYSCON
	default n

endif #SOC_SERIES_DASHKIN
```

## soc/dashkin/Kconfig.series
```kconfig
config SOC_SERIES_DASHKIN
	bool "DASHKIN Processor"
	select RISCV
  select SOC_FAMILY_RISCV_PRIVILEGED
```

## soc/dashkin/Kconfig.soc
```kconfig
choice
	prompt "DASHKIN"
	depends on SOC_SERIES_DASHKIN

config SOC_DASHKIN
  bool "SoC DASHKIN"
	select RISCV_ISA_RV32I
	select RISCV_ISA_EXT_M
	select RISCV_ISA_EXT_C
	select RISCV_ISA_EXT_ZICSR
	select ATOMIC_OPERATIONS_C
	help
	  Enable support for the DASHKIN Processor (SoC).

	  The DASHKIN CPU implementation must have the following RISC-V ISA
	  extensions enabled in order to support Zephyr:
	  - M (Integer Multiplication and Division)
	  - Zicsr (Control and Status Register (CSR) Instructions)

endchoice
```
